## config/west.yml
```yaml
manifest:
  remotes:
    - name: zmkfirmware
      url-base: https://github.com/zmkfirmware
    # Additional modules containing boards/shields/custom code can be listed here as well
    # See https://docs.zephyrproject.org/3.2.0/develop/west/manifest.html#projects
    # support nice_oled and nice_epaper
    - name: mctechnology17
      url-base: https://github.com/mctechnology17
    - name: infely # new entry
      url-base: https://github.com/infely # new entry
    - name: joelspadin
      url-base: https://github.com/joelspadin
  projects:
    - name: zmk
      remote: zmkfirmware
      revision: main
      import: app/west.yml
    # support nice_oled and nice_epaper
    - name: zmk-nice-oled
      remote: mctechnology17
      revision: main
      path: modules/zmk/nice-oled
    - name: nice-view-battery # new entry
      remote: infely # new entry
      revision: main # new entry
      path: modules/zmk/nice-view-battery
    - name: zmk-locales
      remote: joelspadin
      revision: main
      path: modules/zmk/locales
  self:
    path: config
```
